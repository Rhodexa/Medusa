#include "display.h"
#include "pins.h"
#include <SPI.h>

// ---------------------------------------------------------------------------
// WiFi icon — 13×8 pixels + 1 px gap, bit 0 = top pixel.
// ---------------------------------------------------------------------------
static const uint8_t ICON_WIFI[14] = {
    0x08, 0x0C, 0x06, 0x26, 0x13, 0xDB,   // left half
    0xDB, 0xDB,                             // centre
    0x13, 0x26, 0x06, 0x0C, 0x08,          // right half
    0x00                                    // gap before text
};

// ---------------------------------------------------------------------------
// Password icon — 13×8 pixels + 1 px gap, bit 0 = top pixel.
// ---------------------------------------------------------------------------
static const uint8_t ICON_PADLOCK[14] = {
    0x00, 0xF0, 0xF0, 0xFC, 0xFE, 0xF2,
    0x92,
    0xF2, 0xFE, 0xFC, 0xF0, 0xF0, 0x00  
};

static const uint8_t ICON_KEY[14] = {
    0x00, 0x06, 0x06, 0x0F, 0x0F, 0xFD, 0xFD,
    0xFD, 0x0F, 0x0F, 0x06, 0x06, 0x00
};

// ---------------------------------------------------------------------------
// 5×8 bitmap font — ASCII 0x20 (space) to 0x7E (~).
// Each entry is 5 bytes: one per column, LSB = topmost pixel.
// ---------------------------------------------------------------------------
static const uint8_t FONT5x8[95][5] = {
    {0x00,0x00,0x00,0x00,0x00}, // ' '
    {0x00,0x00,0x5F,0x00,0x00}, // '!'
    {0x00,0x07,0x00,0x07,0x00}, // '"'
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    {0x10,0x08,0x08,0x10,0x08}, // '~'
};

// ---------------------------------------------------------------------------
// Framebuffer — 8 pages × 128 columns (64 px tall, 128 px wide)
// ---------------------------------------------------------------------------
#define LCD_W     128
#define LCD_PAGES   8

static uint8_t _fb[LCD_PAGES][LCD_W];

// ---------------------------------------------------------------------------
// Low-level SPI
// ---------------------------------------------------------------------------

static void _cmd(uint8_t c) {
    digitalWrite(PIN_DISP_DC, LOW);
    digitalWrite(PIN_DISP_CS, LOW);
    SPI.transfer(c);
    digitalWrite(PIN_DISP_CS, HIGH);
}

static void _flush() {
    SPI.beginTransaction(SPISettings(9000000, MSBFIRST, SPI_MODE0));
    for (uint8_t page = 0; page < LCD_PAGES; page++) {
        _cmd(0xB0 | page);
        _cmd(0x10);  // column high nibble = 0
        _cmd(0x04);  // column low  nibble = 4 (ADC-normal panels start at segment 4)
        digitalWrite(PIN_DISP_DC, HIGH);
        digitalWrite(PIN_DISP_CS, LOW);
        SPI.writeBytes(_fb[page], LCD_W);
        digitalWrite(PIN_DISP_CS, HIGH);
    }
    SPI.endTransaction();
}

// ---------------------------------------------------------------------------
// Framebuffer drawing
// ---------------------------------------------------------------------------

static void _clear() { memset(_fb, 0, sizeof(_fb)); }

static void _hline(uint8_t page) {
    if (page < LCD_PAGES) memset(_fb[page], 0x18, LCD_W);
}

static void _icon(int x, uint8_t page, const uint8_t* icon, int w) {
    if (page >= LCD_PAGES) return;
    for (int col = 0; col < w && (x + col) < LCD_W; col++)
        _fb[page][x + col] = icon[col];
}

static int _glyph(int x, uint8_t page, char c) {
    if (page >= LCD_PAGES || x >= LCD_W) return x + 6;
    if (c < 0x20 || c > 0x7E) c = '?';
    const uint8_t* g = FONT5x8[(uint8_t)c - 0x20];
    for (int col = 0; col < 5 && (x + col) < LCD_W; col++)
        _fb[page][x + col] = g[col];
    return x + 6;
}

static void _text(int x, uint8_t page, const char* s) {
    while (*s && x < LCD_W) x = _glyph(x, page, *s++);
}

// ---------------------------------------------------------------------------
// Public
// ---------------------------------------------------------------------------

void Display::begin() {
    pinMode(PIN_DISP_DC,  OUTPUT);
    pinMode(PIN_DISP_CS,  OUTPUT);
    pinMode(PIN_DISP_RST, OUTPUT);
    digitalWrite(PIN_DISP_CS, HIGH);

    digitalWrite(PIN_DISP_RST, LOW);  delay(10);
    digitalWrite(PIN_DISP_RST, HIGH); delay(10);

    SPI.begin();
    SPI.beginTransaction(SPISettings(9000000, MSBFIRST, SPI_MODE0));
    _cmd(0xE2); // Software reset
    _cmd(0xA2); // Bias 1/9
    _cmd(0xA0); // ADC normal
    _cmd(0xC8); // COM output reverse
    _cmd(0x25); // Voltage regulator ratio = 5
    _cmd(0x81); // Electronic volume mode
    _cmd(0x17); // Electronic volume = 23
    _cmd(0x2F); // Power: booster + regulator + follower ON
    _cmd(0xAF); // Display ON
    _cmd(0xA4); // All points normal
    _cmd(0x40); // Start line = 0
    SPI.endTransaction();

    _clear();
    _flush();

    _ready = true;
    Serial.println("[Display] ST7565P ready.");
}

void Display::setManagers(NodeManager* nodes, ConfigManager* cfg, WiFiManager* wifi) {
    _nodes = nodes; _cfg = cfg; _wifi = wifi;
}

void Display::tick() {
    if (!_ready) return;
    unsigned long now = millis();
    if (now - _lastDraw < 200) return;
    _lastDraw = now;
    _draw();
}

// ---------------------------------------------------------------------------
// Private
// ---------------------------------------------------------------------------

void Display::_draw() {
    _clear();

    char buf[22];

    // ── TOP HALF: Home WiFi ──────────────────────────────────────────────────

    _icon(0, 0, ICON_WIFI, 13);
    if (_wifi && _wifi->isStaConnected())
        _text(15, 0, _wifi->staSSID().c_str());
    else
        _text(15, 0, "No conectado");

    if (_wifi && _wifi->isStaConnected())
        _text(0, 1, "http://");
        _text(8*5, 1, _wifi->staIP().c_str());

    int n = _nodes ? _nodes->nodeCount() : 0;
    snprintf(buf, sizeof(buf), "Medusas: %d", n);
    _text(0, 2, buf);

    _hline(3);

    // ── BOTTOM HALF: AP ──────────────────────────────────────────────────────

    _text(0, 4, "Pagina Configuacion:");
    _icon(0, 5, ICON_WIFI, 13);
    if (_wifi) _text(15, 5, _wifi->apSSID().c_str());

    _icon(0, 6, ICON_PADLOCK, 13);
    _text(15, 6, MEDUSA_AP_PASS);
    _text(0, 7, "http://");
    _text(8*5, 7, "192.168.4.1");

    _flush();
}
